## firmware/example/main/Kconfig.projbuild
```kconfig
menu "rbs_tsync example"

config EXAMPLE_NODE_LETTER
    string "Node letter (1 char, unique per board)"
    default "a"

config EXAMPLE_NODE_ID
    string "Node id (report 'node' field + topic suffix)"
    default "esp32a"

config EXAMPLE_USE_WIFI
    bool "Publish over WiFi/MQTT (else print reports to UART)"
    default n

config EXAMPLE_WIFI_SSID
    string "WiFi SSID"
    depends on EXAMPLE_USE_WIFI
    default "myssid"

config EXAMPLE_WIFI_PASSWORD
    string "WiFi password"
    depends on EXAMPLE_USE_WIFI
    default "mypassword"

config EXAMPLE_MQTT_URI
    string "MQTT broker URI"
    depends on EXAMPLE_USE_WIFI
    default "mqtt://192.168.1.10"

endmenu
```

## firmware/example/sdkconfig.defaults
```kconfig
# --- NimBLE: broadcaster (announce) + observer (passive scan) ---
CONFIG_BT_ENABLED=y
CONFIG_BT_NIMBLE_ENABLED=y
CONFIG_BT_NIMBLE_ROLE_BROADCASTER=y
CONFIG_BT_NIMBLE_ROLE_OBSERVER=y
# Leave CENTRAL/PERIPHERAL at their NimBLE defaults (y): disabling them trips an
# ESP-IDF v5.3 build bug (ble_adv_reattempt undeclared) on the broadcaster path.
CONFIG_BT_NIMBLE_MEM_ALLOC_MODE_EXTERNAL=y

# --- PSRAM (ESP32-S3 octal) for the ring + task stacks ---
CONFIG_SPIRAM=y
CONFIG_SPIRAM_MODE_OCT=y
CONFIG_SPIRAM_MALLOC_ALWAYSINTERNAL=1024
CONFIG_SPIRAM_TRY_ALLOCATE_WIFI_LWIP=y

# --- console over USB-JTAG (ESP32-S3 devkits) ---
CONFIG_ESP_CONSOLE_USB_SERIAL_JTAG=y

# WiFi+BLE coexistence (only relevant when EXAMPLE_USE_WIFI=y)
CONFIG_ESP_COEX_SW_COEXIST_ENABLE=y
```
